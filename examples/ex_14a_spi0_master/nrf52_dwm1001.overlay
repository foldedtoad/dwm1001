/*
 * Copyright (c) 2019 Callender-Consulting, LLC
 *
 * SPDX-License-Identifier: Apache-2.0
 */

&i2c0 {
	status = "disabled";
};

&spi0 {
	compatible = "nordic,nrf-spi";
	status = "okay";
	mosi-pin = <12>;                 // M-PIN 6  	(3)
	miso-pin = <27>;                 // M-PIN 13	(4)
	sck-pin  = <23>;                 // M-PIN 16	(7)
	cs-gpios = <&gpio0 13 0>;        // M-PIN 17	(8)
};
