## boards/arm/nrf52_dwm1001/Kconfig
```kconfig
# Kconfig - nRF52 DWM1001 board configuration
#
# Copyright (c) 2016 Nordic Semiconductor ASA
# Copyright (c) 2019 RTLOC
#
# SPDX-License-Identifier: Apache-2.0

if BOARD_NRF52_DWM1001

config BOARD_ENABLE_DCDC
	bool "Enable DCDC mode"
	select SOC_DCDC_NRF52X
	default y

# BT_CTLR depends on BT. When BT is enabled we should default to also
# enabling the controller.
config BT_CTLR
	default y if BT

endif # BOARD_NRF52_DWM1001
```

## boards/arm/nrf52_dwm1001/Kconfig.board
```kconfig
# Kconfig - nRF52 DWM1001 board configuration
#
# Copyright (c) 2016 Nordic Semiconductor ASA
# Copyright (c) 2019 RTLOC
#
# SPDX-License-Identifier: Apache-2.0

config  BOARD_NRF52_DWM1001
	bool "nRF52 DWM1001"
	depends on SOC_NRF52832_QFAA
```

## boards/arm/nrf52_dwm1001/Kconfig.defconfig
```kconfig
# Kconfig - nRF52 DWM1001 board configuration
#
# Copyright (c) 2016 Nordic Semiconductor ASA
# Copyright (c) 2019 RTLOC
#
# SPDX-License-Identifier: Apache-2.0

if BOARD_NRF52_DWM1001

config BOARD
	default "nrf52_dwm1001"

config I2C_0
	default y
	depends on I2C

config BT_CTLR
	default BT

endif # BOARD_NRF52_DWM1001
```

## boards/arm/nrf52_dwm1001/nrf52_dwm1001_defconfig
```kconfig
CONFIG_SOC_SERIES_NRF52X=y
CONFIG_SOC_NRF52832_QFAA=y
CONFIG_BOARD_NRF52_DWM1001=y

# Enable MPU
CONFIG_ARM_MPU=y

# Enable RTT
CONFIG_USE_SEGGER_RTT=y

# enable uart driver
CONFIG_SERIAL=y

# enable console
CONFIG_CONSOLE=y
CONFIG_UART_CONSOLE=y
CONFIG_RTT_CONSOLE=y

# additional board options
CONFIG_GPIO_AS_PINRESET=y
```

## dts/bindings/gpio/gpio-generic.yaml
```yaml
# Copyright (c) 2020 Callender Consulting, LLC
# SPDX-License-Identifier: Apache-2.0

description: GPIO generic parent node

compatible: "gpio-generic"

child-binding:
    description: GPIO KEYS child node
    properties:
        gpios:
            type: phandle-array
            required: true
        label:
            type: string
            required: true
```

## dts/bindings/qorvo,dwm1001/qorvo,dwm1001.yaml
```yaml
# Copyright (c) 2024, Callender-Consulting, LLC.
# SPDX-License-Identifier: Apache-2.0

description: Qorvo DWM1001 controller on SPI bus

compatible: "qorvo,dwm1001"

include: [spi-device.yaml]
```
